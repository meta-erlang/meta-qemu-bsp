## conf/layer.conf
```bitbake
# We have a conf and classes directory, add to BBPATH
BBPATH .= ":${LAYERDIR}"

# We have recipes-* directories, add to BBFILES
BBFILES += "${LAYERDIR}/recipes-*/*/*.bb \
            ${LAYERDIR}/recipes-*/*/*.bbappend"

BBFILE_COLLECTIONS += "qemu-bsp-layer"
BBFILE_PATTERN_qemu-bsp-layer = "^${LAYERDIR}/"
BBFILE_PRIORITY_qemu-bsp-layer = "5"
LAYERVERSION_qemu-bsp-layer = "4"
LAYERSERIES_COMPAT_qemu-bsp-layer = "styhead walnascar"
```
